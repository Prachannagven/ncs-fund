## l2_e1/build/l2_e1/Kconfig/boards/Kconfig.defconfig
```kconfig
# Load Zephyr board defconfig descriptions.
osource "/home/pranav/ncs/v3.2.1/zephyr/boards/nordic/nrf52840dk/Kconfig.defconfig"
```

## l4_e1/build/Kconfig/boards/Kconfig
```kconfig
# Load Zephyr board Kconfig descriptions.
osource "/home/pranav/ncs/v3.2.1/zephyr/boards/nordic/nrf52840dk/Kconfig"
```

## l5_e1/build/l5_e1/Kconfig/arch/Kconfig
```kconfig
# Load Zephyr Arch Kconfig descriptions.
osource "/home/pranav/ncs/v3.2.1/zephyr/arch/rx/Kconfig"
osource "/home/pranav/ncs/v3.2.1/zephyr/arch/x86/Kconfig"
osource "/home/pranav/ncs/v3.2.1/zephyr/arch/xtensa/Kconfig"
osource "/home/pranav/ncs/v3.2.1/zephyr/arch/sparc/Kconfig"
osource "/home/pranav/ncs/v3.2.1/zephyr/arch/riscv/Kconfig"
osource "/home/pranav/ncs/v3.2.1/zephyr/arch/posix/Kconfig"
osource "/home/pranav/ncs/v3.2.1/zephyr/arch/mips/Kconfig"
osource "/home/pranav/ncs/v3.2.1/zephyr/arch/arm64/Kconfig"
osource "/home/pranav/ncs/v3.2.1/zephyr/arch/arm/Kconfig"
osource "/home/pranav/ncs/v3.2.1/zephyr/arch/arc/Kconfig"
```
