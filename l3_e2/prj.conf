## Kconfig
```
source "Kconfig.zephyr"

config MYFUNCTION
	bool "Enable my function"
	default n
```

## prj.conf
```kconfig
CONFIG_GPIO=y
CONFIG_SERIAL=y
CONFIG_CONSOLE=y
CONFIG_UART_CONSOLE=y
CONFIG_MYFUNCTION=y
```

## boards/nrf52840dk_nrf52840.overlay
```dts
&uart0 {
	current-speed = <9600>;
	hw-flow-control;
	data-bits = <8>;
	stop-bits = "2";
	parity = "none";
};
```

## src/main.c
```c
#include <stdio.h>
#include <zephyr/kernel.h>
#include <zephyr/sys/printk.h>
#include <zephyr/drivers/gpio.h>
#ifdef CONFIG_MYFUNCTION 
#include "myfunction.h"
#endif

#define LED0_NODE DT_ALIAS(led0)
static const struct gpio_dt_spec led0 = GPIO_DT_SPEC_GET(LED0_NODE, gpios);

int main(void)
{
	int ret;
	if(!gpio_is_ready_dt(&led0)) {
		printf("Error: LED device %s is not ready\n", led0.port->name);
		return 0;
	}
	ret = gpio_pin_configure_dt(&led0, GPIO_OUTPUT_ACTIVE);
	if (ret < 0) {
		printf("Error %d: failed to configure LED pin %d\n", ret, led0.pin);
		return 0;
	}

	while (1) {
#ifdef CONFIG_MYFUNCTION
		int a = 3, b = 4;
		printk("The sum of %d and %d is %d \n ", a, b, sum(a, b));
#else
		printk("MYFUNCTION not enabled \n");
#endif
		gpio_pin_toggle_dt(&led0);
		k_msleep(1000);
	}
}
```

## src/myfunction.c
```c
#include "myfunction.h"

int sum(int a, int b){
	return a+b;
}
```
